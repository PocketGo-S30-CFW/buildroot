## configs/pocketgo_s30_defconfig
```kconfig
BR2_GLOBAL_PATCH_DIR="board/pocketgo/pocketgo-s30/patches"

# Architecture
BR2_arm=y
BR2_cortex_a7=y

# System
BR2_ROOTFS_OVERLAY="board/pocketgo/pocketgo-s30/rootfs_overlay"

# Toolchain
BR2_TOOLCHAIN_USES_GLIBC=y

# Toolchain Buildroot Options
BR2_TOOLCHAIN_BUILDROOT_VENDOR="buildroot"
BR2_TOOLCHAIN_BUILDROOT_GLIBC=y
BR2_TOOLCHAIN_BUILDROOT_LIBC="glibc"

# GCC Options
BR2_GCC_VERSION_10_X=y
BR2_GCC_SUPPORTS_DLANG=y
BR2_GCC_VERSION="10.3.0"
BR2_EXTRA_GCC_CONFIG_OPTIONS=""
BR2_TOOLCHAIN_BUILDROOT_CXX=y
BR2_GCC_ENABLE_OPENMP=y
BR2_PACKAGE_HOST_GDB_ARCH_SUPPORTS=y

# Linux headers same as kernel, a 5.16 series
BR2_PACKAGE_HOST_LINUX_HEADERS_CUSTOM_5_16=y

# System configuration
BR2_TARGET_GENERIC_HOSTNAME="PocketGo-S30"
BR2_TARGET_GENERIC_ISSUE="Welcome to PocketGo-S30!"

# Bootloaders
BR2_TARGET_UBOOT=y
BR2_TARGET_UBOOT_BUILD_SYSTEM_KCONFIG=y
BR2_TARGET_UBOOT_CUSTOM_GIT=y
BR2_TARGET_UBOOT_CUSTOM_REPO_URL="https://github.com/PocketGo-S30-CFW/u-boot.git"
BR2_TARGET_UBOOT_CUSTOM_REPO_VERSION="pocketgo-s30"
BR2_TARGET_UBOOT_BOARD_DEFCONFIG="PocketGo_s30_a33"
BR2_TARGET_UBOOT_NEEDS_DTC=y
BR2_TARGET_UBOOT_NEEDS_PYLIBFDT=y
BR2_TARGET_UBOOT_FORMAT_BIN=y
BR2_TARGET_UBOOT_SPL=y
BR2_TARGET_UBOOT_SPL_NAME="u-boot-sunxi-with-spl.bin"
BR2_PACKAGE_HOST_UBOOT_TOOLS=y
BR2_PACKAGE_HOST_UBOOT_TOOLS_BOOT_SCRIPT=y
BR2_PACKAGE_HOST_UBOOT_TOOLS_BOOT_SCRIPT_SOURCE="board/pocketgo/pocketgo-s30/boot.cmd"

# Kernel
BR2_LINUX_KERNEL=y
BR2_LINUX_KERNEL_CUSTOM_GIT=y
BR2_LINUX_KERNEL_CUSTOM_REPO_URL="https://github.com/PocketGo-S30-CFW/linux.git"
BR2_LINUX_KERNEL_CUSTOM_REPO_VERSION="pocketgo-s30"
BR2_LINUX_KERNEL_DTS_SUPPORT=y
BR2_LINUX_KERNEL_INTREE_DTS_NAME="sun8i-a33-pocketgo-s30"
BR2_LINUX_KERNEL_INSTALL_TARGET=y
BR2_LINUX_KERNEL_USE_CUSTOM_CONFIG=y
BR2_LINUX_KERNEL_CUSTOM_CONFIG_FILE="board/pocketgo/pocketgo-s30/linux.config"

# Filesystem
BR2_TARGET_ROOTFS_EXT2=y
BR2_TARGET_ROOTFS_EXT2_4=y
BR2_ROOTFS_POST_BUILD_SCRIPT="board/pocketgo/pocketgo-s30/post-build.sh"
BR2_ROOTFS_POST_IMAGE_SCRIPT="support/scripts/genimage.sh"
BR2_ROOTFS_POST_SCRIPT_ARGS="-c board/pocketgo/pocketgo-s30/genimage.cfg"

# Additional tools
BR2_PACKAGE_HOST_DOSFSTOOLS=y
BR2_PACKAGE_HOST_GENIMAGE=y
BR2_PACKAGE_HOST_UBOOT_TOOLS=y
BR2_PACKAGE_HOST_MTOOLS=y
BR2_PACKAGE_ANDROID_TOOLS_ADBD=y
```
